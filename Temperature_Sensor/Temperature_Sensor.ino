/*
Program for a Temperature sensor that controls LEDs.
+ learning for and &&
-- with bugs!!!
*/
const int sensorPin = A0;
//const float baselineTemp = 20.0; //floats store decimal values (as opposed to ints)
void setup() {
    Serial.begin(9600); //opens serial port
    
    for(int pinNumber =2; pinNumber<5; pinNumber ++){ //for loop 
      pinMode(pinNumber, OUTPUT);
      digitalWrite(pinNumber, LOW); //initializes pin vals w less code
    }
}

void loop() {
  int sensorVal = analogRead(sensorPin);
  Serial.print("Sensor value: ");
  Serial.print(sensorVal);
  
  //Analog pins in A0-A5 can report back a value between 0-1023, which maps to a range from 0-5V
  //float voltage = (sensorVal/1024.0) * 5.0; //converts ADC value to voltage
  float voltage = (sensorVal-130)/2;
  
  Serial.print(" New value: ");
  Serial.println(voltage);
  //Serial.print(", degrees C: ");
  //float temperature = (voltage -.5) * 100;
  //Serial.println(temperature);
  
  //if (temperature <= baselineTemp){
  if (voltage <= 0){
    Serial.println("All lights off");
    digitalWrite(2, LOW);
    digitalWrite(3, LOW);
    digitalWrite(4, LOW);
  }
  //}else if((temperature >= baselineTemp + 2) && (temperature < baselineTemp+4)){
  else if ((voltage > 0)&&(voltage <= 2)) {
    //&& is the "AND" operator
    //|| is the "OR" operator
    Serial.println("Green light on");
    digitalWrite(2, HIGH);
    digitalWrite(3, LOW);
    digitalWrite(4, LOW);
  }
  //else if((temperature >= baselineTemp + 4) && (temperature < baselineTemp+6)){
    else if ((voltage > 2)&&(voltage <= 4)){
    Serial.println("Two lights on");
    digitalWrite(2, HIGH);
    digitalWrite(3, HIGH);
    digitalWrite(4, LOW);
  }
  //else if(temperature >= baselineTemp + 6){
  else if (voltage > 4){
    Serial.println("All lights on");
    digitalWrite(2, HIGH);
    digitalWrite(3, HIGH);
    digitalWrite(4, HIGH);
  }
  delay(1);
}
